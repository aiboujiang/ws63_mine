## src/application/Kconfig
```kconfig
#===============================================================================
# @brief    Kconfig file.
# Copyright (c) HiSilicon (Shanghai) Technologies Co., Ltd. 2023-2023. All rights reserved.
#===============================================================================

config SAMPLE_ENABLE
    bool
    prompt "Enable Sample."
    default n
    help
        This option means support Samples.

if SAMPLE_ENABLE
osource "application/samples/Kconfig"
endif

config MINE_ENABLE
    bool
    prompt "Enable Mine Demos."
    default n
    help
        This option means support custom demos under application/mine.

if MINE_ENABLE
osource "application/mine/Kconfig"
endif
```

## src/application/samples/Farsight/Kconfig
```kconfig
config SAMPLE_SUPPORT_KERNEL_01_TASK
    bool
    prompt "Support KERNEL_01_TASK Sample."
    default n
    depends on ENABLE_FARSIGHT_SAMPLE
    help
        This option means support KERNEL_01_TASK Sample.

config SAMPLE_SUPPORT_KERNEL_02_TIMER
    bool
    prompt "Support KERNEL_02_TIMER Sample."
    default n
    depends on ENABLE_FARSIGHT_SAMPLE
    help
        This option means support KERNEL_02_TIMER Sample.

config SAMPLE_SUPPORT_KERNEL_03_EVENT
    bool
    prompt "Support KERNEL_03_EVENT Sample."
    default n
    depends on ENABLE_FARSIGHT_SAMPLE
    help
        This option means support KERNEL_03_EVENT Sample.

config SAMPLE_SUPPORT_KERNEL_04_MUTEX
    bool
    prompt "Support KERNEL_04_MUTEX Sample."
    default n
    depends on ENABLE_FARSIGHT_SAMPLE
    help
        This option means support KERNEL_04_MUTEX Sample.

config SAMPLE_SUPPORT_KERNEL_05_MUTEX_SEMAPHORE
    bool
    prompt "Support KERNEL_05_MUTEX_SEMAPHORE Sample."
    default n
    depends on ENABLE_FARSIGHT_SAMPLE
    help
        This option means support KERNEL_05_MUTEX_SEMAPHORE Sample.

config SAMPLE_SUPPORT_KERNEL_06_SYNC_SEMAPHORE
    bool
    prompt "Support KERNEL_06_SYNC_SEMAPHORE Sample."
    default n
    depends on ENABLE_FARSIGHT_SAMPLE
    help
        This option means support KERNEL_06_SYNC_SEMAPHORE Sample.

config SAMPLE_SUPPORT_KERNEL_07_COUNT_SEMAPHORE
    bool
    prompt "Support KERNEL_07_COUNT_SEMAPHORE Sample."
    default n
    depends on ENABLE_FARSIGHT_SAMPLE
    help
        This option means support KERNEL_07_COUNT_SEMAPHORE Sample.

config SAMPLE_SUPPORT_KERNEL_08_MESSGE_QUEQUE
    bool
    prompt "Support KERNEL_08_MESSGE_QUEQUE Sample."
    default n
    depends on ENABLE_FARSIGHT_SAMPLE
    help
        This option means support KERNEL_08_MESSGE_QUEQUE Sample.

config SAMPLE_SUPPORT_KERNEL_09_NV
    bool
    prompt "Support KERNEL_09_NV Sample."
    default n
    depends on ENABLE_FARSIGHT_SAMPLE
    help
        This option means support KERNEL_09_NV Sample.

config SAMPLE_SUPPORT_KERNEL_10_MENU
    bool
    prompt "Support KERNEL_10_MENU Sample."
    default n
    depends on ENABLE_FARSIGHT_SAMPLE
    help
        This option means support KERNEL_10_MENU Sample.

config SAMPLE_SUPPORT_LEDBLINK
    bool
    prompt "Support BASE_01_LED_BLINK Sample."
    default n
    depends on ENABLE_FARSIGHT_SAMPLE
    help
        This option means support LEDBLINK Sample.

config SAMPLE_SUPPORT_UART
    bool
    prompt "Support BASE_02_UART Sample."
    default n
    depends on ENABLE_FARSIGHT_SAMPLE
    help
        This option means support UART Sample.
        
config SAMPLE_SUPPORT_OLED_SSD1306
    bool
    prompt "Support BASE_03_OLED_SSD1306 Sample."
    default n
    depends on ENABLE_FARSIGHT_SAMPLE
    help
        This option means support OLED_SSD1306 Sample.

config SAMPLE_SUPPORT_RGB
    bool
    prompt "Support BASE_04_RGB Sample."
    default n
    depends on ENABLE_FARSIGHT_SAMPLE
    help
        This option means support RGB Sample.

config SAMPLE_SUPPORT_SHT20
    bool
    prompt "Support BASE_05_SHT20 Sample."
    default n
    depends on ENABLE_FARSIGHT_SAMPLE
    help
        This option means support SHT20 Sample.

config SAMPLE_SUPPORT_AP3216
    bool
    prompt "Support BASE_06_AP3216 Sample."
    default n
    depends on ENABLE_FARSIGHT_SAMPLE
    help
        This option means support AP3216 Sample.

config SAMPLE_SUPPORT_LCD
    bool
    prompt "Support BASE_07_LCD Sample."
    default n
    depends on ENABLE_FARSIGHT_SAMPLE
    help
        This option means support LCD Sample.

config SAMPLE_SUPPORT_LCD_TOUCH
    bool
    prompt "Support BASE_08_LCD_TOUCH Sample."
    default n
    depends on ENABLE_FARSIGHT_SAMPLE
    help
        This option means support LCD_TOUCH Sample.

config SAMPLE_SUPPORT_NFC
    bool
    prompt "Support BASE_09_NFC Sample."
    default n
    depends on ENABLE_FARSIGHT_SAMPLE
    help
        This option means support NFC Sample.

config SAMPLE_SUPPORT_IR_RECV
    bool
    prompt "Support BASE_10_IR_RECV Sample."
    default n
    depends on ENABLE_FARSIGHT_SAMPLE
    help
        This option means support IR_RECV Sample.
        
config SAMPLE_SUPPORT_SC12B
    bool
    prompt "Support BASE_11_SC12B Sample."
    default n
    depends on ENABLE_FARSIGHT_SAMPLE
    help
        This option means support SC12B Sample.

config SAMPLE_SUPPORT_TELECONTROL_OLED
    bool
    prompt "Support BASE_12_TELECONTROL_OLED Sample."
    default n
    depends on ENABLE_FARSIGHT_SAMPLE
    help
        This option means support TELECONTROL_OLED Sample.

config SAMPLE_SUPPORT_SMART_TRASHCAN
    bool
    prompt "Support MODULE_01_SMART_TRASHCAN Sample."
    default n
    depends on ENABLE_FARSIGHT_SAMPLE
    help
        This option means support SMART_TRASHCAN Sample.

config SAMPLE_SUPPORT_EC800M
    bool
    prompt "Support MODULE_02_EC800M Sample."
    default n
    depends on ENABLE_FARSIGHT_SAMPLE
    help
        This option means support EC800M Sample.
        
config SAMPLE_SUPPORT_VOICE_CAR
    bool
    prompt "Support MODULE_03_VOICE_CAR Sample."
    default n
    depends on ENABLE_FARSIGHT_SAMPLE
    help
        This option means support VOICE_CAR Sample.

config SAMPLE_SUPPORT_FINGERPRINT_LOCK
    bool
    prompt "Support MODULE_04_FINGERPRINT_LOCK Sample."
    default n
    depends on ENABLE_FARSIGHT_SAMPLE
    help
        This option means support FINGERPRINT_LOCK Sample.

config SAMPLE_SUPPORT_SMART_AGRICULTURE
    bool
    prompt "Support MODULE_05_SMART_AGRICULTURE Sample."
    default n
    depends on ENABLE_FARSIGHT_SAMPLE
    help
        This option means support SMART_AGRICULTURE Sample.
        
config SAMPLE_SUPPORT_REVERSINGRADA
    bool
    prompt "Support SAMPLE_01_REVERSINGRADA Sample."
    default n
    depends on ENABLE_FARSIGHT_SAMPLE
    help
     This option means support REVERSINGRADA Sample.

config SAMPLE_SUPPORT_SMARTTEMP
    bool
    prompt "Support SAMPLE_02_SMARTTEMP Sample."
    default n
    depends on ENABLE_FARSIGHT_SAMPLE
    help
     This option means support SMARTTEMP Sample.

config SAMPLE_SUPPORT_SMARTSECURITY
    bool
    prompt "Support SAMPLE_03_SMARTSECURITY Sample."
    default n
    depends on ENABLE_FARSIGHT_SAMPLE
    help
     This option means support SMARTSECURITY Sample.

config SAMPLE_SUPPORT_SMARTLAMP
    bool
    prompt "Support SAMPLE_04_SMARTLAMP Sample."
    default n
    depends on ENABLE_FARSIGHT_SAMPLE
    help
     This option means support SMARTLAMP Sample.

config SAMPLE_SUPPORT_SMARTFARM
    bool
    prompt "Support SAMPLE_05_SMARTFARM Sample."
    default n
    depends on ENABLE_FARSIGHT_SAMPLE
    help
     This option means support SMARTFARM Sample.

config SAMPLE_SUPPORT_SMARTHOME
    bool
    prompt "Support SAMPLE_06_SMARTHOME Sample."
    default n
    depends on ENABLE_FARSIGHT_SAMPLE
    help
     This option means support SMARTHOME Sample.

config SAMPLE_SUPPORT_WIFI_01_STA
    bool
    prompt "Support WIFI_01_STA Sample."
    default n
    depends on ENABLE_FARSIGHT_SAMPLE
    help
        This option means support WIFI_01_STA Sample.

config SAMPLE_SUPPORT_WIFI_02_AP
    bool
    prompt "Support WIFI_02_AP Sample."
    default n
    depends on ENABLE_FARSIGHT_SAMPLE
    help
        This option means support WIFI_02_AP Sample.

config SAMPLE_SUPPORT_WIFI_03_UDP
    bool
    prompt "Support WIFI_03_UDP Sample."
    default n
    depends on ENABLE_FARSIGHT_SAMPLE
    help
        This option means support WIFI_03_UDP Sample.

config SAMPLE_SUPPORT_WIFI_04_TCP
    bool
    prompt "Support WIFI_04_TCP Sample."
    default n
    depends on ENABLE_FARSIGHT_SAMPLE
    help
        This option means support WIFI_04_TCP Sample.

config SAMPLE_SUPPORT_WIFI_05_MQTT
    bool
    prompt "Support WIFI_05_MQTT Sample."
    default n
    depends on ENABLE_FARSIGHT_SAMPLE
    help
        This option means support WIFI_05_MQTT Sample.

config SAMPLE_SUPPORT_WIFI_06_HUAWEI_IOT
    bool
    prompt "Support WIFI_06_HUAWEI_IOT Sample."
    default n
    depends on ENABLE_FARSIGHT_SAMPLE
    help
        This option means support WIFI_06_HUAWEI_IOT Sample.

config SAMPLE_SUPPORT_WIFI_07_HTTP
    bool
    prompt "Support WIFI_07_HTTP Sample."
    default n
    depends on ENABLE_FARSIGHT_SAMPLE
    help
        This option means support WIFI_07_HTTP Sample.

config SAMPLE_SUPPORT_WIFI_08_SPEED_AP
    bool
    prompt "Support WIFI_08_SPEED_AP Sample."
    default n
    depends on ENABLE_FARSIGHT_SAMPLE
    help
        This option means support WIFI_08_SPEED_AP Sample.

config SAMPLE_SUPPORT_WIFI_08_SPEED_STA
    bool
    prompt "Support WIFI_08_SPEED_STA Sample."
    default n
    depends on ENABLE_FARSIGHT_SAMPLE
    help
        This option means support WIFI_08_SPEED_STA Sample.

config SAMPLE_SUPPORT_BLE_TRANS_SERVER
    bool
    prompt "Support BLE_01_TRANS_SERVER Sample."
    default n
    depends on ENABLE_FARSIGHT_SAMPLE
    help
        This option means support BLE_TRANS_SERVER Sample.

config SAMPLE_SUPPORT_BLE_TRANS_CLIENT
    bool
    prompt "Support BLE_02_TRANS_CLIENT Sample."
    default n
    depends on ENABLE_FARSIGHT_SAMPLE
    help
        This option means support BLE_TRANS_CLIENT Sample.

config SAMPLE_SUPPORT_BLE_WIFI_CFG_SERVER
    bool
    prompt "Support BLE_03_WIFI_CFG_SERVER Sample."
    default n
    depends on ENABLE_FARSIGHT_SAMPLE
    help
        This option means support BLE_WIFI_CFG_SERVER Sample.

config SAMPLE_SUPPORT_SLE_TRANS_SERVER
    bool
    prompt "Support SLE_TRANS_SERVER Sample."
    default n
    depends on ENABLE_FARSIGHT_SAMPLE
    help
        This option means support SLE_TRANS_SERVER Sample.


config SAMPLE_SUPPORT_SLE_TRANS_CLIENT
    bool
    prompt "Support SLE_TRANS_CLIENT Sample."
    default n
    depends on ENABLE_FARSIGHT_SAMPLE
    help
        This option means support SLE_TRANS_CLIENT Sample.


config SAMPLE_SUPPORT_SLE_TRANS_CLIENT_MULTI
    bool
    prompt "Support SLE_TRANS_CLIENT_MULTI Sample."
    default n
    depends on ENABLE_FARSIGHT_SAMPLE
    help
        This option means support SLE_TRANS_CLIENT_MULTI Sample.

config SAMPLE_SUPPORT_SLE_SERVER_LED
    bool
    prompt "Support SLE_SERVER_LED Sample."
    default n
    depends on ENABLE_FARSIGHT_SAMPLE
    help
        This option means support SLE_SERVER_LED Sample.

config SAMPLE_SUPPORT_SLE_REMOTECAR_CLIENT
    bool
    prompt "Support SLE_REMOTECAR_CLIENT Sample."
    default n
    depends on ENABLE_FARSIGHT_SAMPLE
    help
        This option means support SLE_REMOTECAR_CLIENT Sample.

config SAMPLE_SUPPORT_SLE_REMOTECAR_SERVER
    bool
    prompt "Support SLE_REMOTECAR_SERVER Sample."
    default n
    depends on ENABLE_FARSIGHT_SAMPLE
    help
        This option means support SLE_REMOTECAR_SERVER Sample.



config SAMPLE_SUPPORT_SLE_DISTRIBUTE_NETWORK
    bool
    prompt "Support SLE_DISTRIBUTE_NETWORK Sample."
    default n
    depends on ENABLE_FARSIGHT_SAMPLE
    help
        This option means support SLE_DISTRIBUTE_NETWORK Sample.

config SAMPLE_SUPPORT_SLE_WIFI_COEXIST_CLIENT
    bool
    prompt "Support SLE_WIFI_COEXIST_CLIENT Sample."
    default n
    depends on ENABLE_FARSIGHT_SAMPLE
    help
        This option means support SLE_WIFI_COEXIST_CLIENT Sample.

config SAMPLE_SUPPORT_SLE_WIFI_COEXIST_SERVER
    bool
    prompt "Support SLE_WIFI_COEXIST_SERVER Sample."
    default n
    depends on ENABLE_FARSIGHT_SAMPLE
    help
        This option means support SLE_WIFI_COEXIST_SERVER Sample.

config SAMPLE_SUPPORT_LVGL_01_KEY_DEMO
    bool
    prompt "Support LVGL_01_KEY_DEMO Sample."
    default n
    depends on ENABLE_FARSIGHT_SAMPLE
    help
        This option means support LVGL_01_KEY_DEMO Sample.

config SAMPLE_SUPPORT_LVGL_02_INTELIGENT_LIGHT
    bool
    prompt "Support LVGL_02_INTELIGENT_LIGHT Sample."
    default n
    depends on ENABLE_FARSIGHT_SAMPLE
    help
        This option means support LVGL_02_INTELIGENT_LIGHT Sample.

config SAMPLE_SUPPORT_LVGL_03_GREEN_HOUSE
    bool
    prompt "Support LVGL_03_GREEN_HOUSE Sample."
    default n
    depends on ENABLE_FARSIGHT_SAMPLE
    help
        This option means support LVGL_03_GREEN_HOUSE Sample.

config SAMPLE_SUPPORT_LVGL_04_FLAME_ALARM
    bool
    prompt "Support LVGL_04_FLAME_ALARM Sample."
    default n
    depends on ENABLE_FARSIGHT_SAMPLE
    help
        This option means support LVGL_04_FLAME_ALARM Sample.

config SAMPLE_SUPPORT_TOTAL_TEST
    bool
    prompt "Support TOTAL_TEST Sample."
    default n
    depends on ENABLE_FARSIGHT_SAMPLE
    help
        This option means support TOTAL_TEST Sample.

config SAMPLE_SUPPORT_SLE_BASE
    bool
    prompt "Support SLE_BASE Sample."
    default n
    depends on ENABLE_FARSIGHT_SAMPLE
    help
        This option means support SLE_BASE Sample.
if SAMPLE_SUPPORT_SLE_BASE
    osource "application/samples/Farsight/sle_base/Kconfig"
endif
```
