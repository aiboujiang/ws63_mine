## src/application/mine/Kconfig
```kconfig
#===============================================================================
# @brief    Kconfig file for custom mine demos.
#===============================================================================

choice
    prompt "Mine SLE UART Demo Role"
    optional

config MINE_SUPPORT_SLE_UART_HOST_DEMO
    bool "Support Mine SLE UART Host Demo."
    help
        Build host side demo (SLE server + UART0 bridge).

config MINE_SUPPORT_SLE_UART_SLAVE_DEMO
    bool "Support Mine SLE UART Slave Demo."
    help
        Build slave side demo (SLE client + UART0 bridge).

endchoice

config MINE_SUPPORT_UART2_EXT_WK2114
    bool "Support Mine UART2 Expand via WK2114."
    default n
    help
        Build the Mine WK2114 UART2 extension skeleton module.
        This module provides a software framework for extending one UART2
        host port into four sub UART channels via WK2114.

config MINE_SUPPORT_WS63_FINAL_LAYERED
    bool "Support Mine WS63 final layered framework (WS63 master)."
    default y
    help
        Build the final layered framework under application/mine/ws63_final.
        In this framework, WS63 is the main controller and WK2114 is treated
        as an external expansion chip in Driver layer.

if MINE_SUPPORT_WS63_FINAL_LAYERED

config MINE_WS63_FINAL_SLE_SLAVE_CORE
    bool "WS63 final: enable SLE slave core bridge."
    default y
    help
        Enable SLE slave core bridge in ws63_final.
        This module handles scan/connect/discovery and provides
        UART-subport uplink/downlink channel to SLE host.

config MINE_WS63_FINAL_SLE_LD2402
    bool "WS63 final: enable LD2402 module uplink."
    default n
    help
        Enable LD2402 data path in ws63_final SLE bridge.
        If disabled, LD2402 sub-port data will not be forwarded to SLE host.

config MINE_WS63_FINAL_SLE_ZW101
    bool "WS63 final: enable ZW101 module uplink."
    default n
    help
        Enable ZW101 data path in ws63_final SLE bridge.
        If disabled, ZW101 sub-port data will not be forwarded to SLE host.

config MINE_WS63_FINAL_SLE_CAMERA
    bool "WS63 final: enable CAMERA module uplink."
    default n
    help
        Enable CAMERA sub-port data path in ws63_final SLE bridge.
        If disabled, CAMERA sub-port data will not be forwarded to SLE host.

endif

config MINE_SUPPORT_RGB_LED_DEMO
    bool "Support Mine RGB LED Demo (WS2812/GPIO9)."
    default n
    help
        Build WS2812 RGB LED demo under application/mine/rgb_led.
        Default data pin is GPIO9.
        The demo prefers SPI+DMA output and falls back to GPIO bit-bang automatically.
        The demo cycles R/G/B colors in GRB transfer order.

config MINE_SUPPORT_BEEP_DEMO
    bool "Support Mine Beep Demo (GPIO3/PWM3)."
    default n
    help
        Build passive buzzer demo under application/mine/beep.
        GPIO3 should be configured as mux mode 1 (PWM3 output).
        The demo supports multi-tone playback with robust error handling.
```

## src/application/samples/peripheral/uart/Kconfig
```kconfig
#===============================================================================
# @brief    Kconfig file.
# Copyright (c) HiSilicon (Shanghai) Technologies Co., Ltd. 2023-2023. All rights reserved.
#===============================================================================
config UART_BUS_ID
    int
    prompt "Choose UART bus id for TX test."
    depends on SAMPLE_SUPPORT_UART
    default 2

config UART_TXD_PIN
    int
    prompt "Choose UART TXD pin for TX test."
    depends on SAMPLE_SUPPORT_UART
    default 8

config UART_RXD_PIN
    int
    prompt "Choose UART RXD pin for init check."
    depends on SAMPLE_SUPPORT_UART
    default 7

config UART_TXD_PIN_MODE
    int
    prompt "Choose UART TXD pin mode."
    depends on SAMPLE_SUPPORT_UART
    default 2

config UART_RXD_PIN_MODE
    int
    prompt "Choose UART RXD pin mode."
    depends on SAMPLE_SUPPORT_UART
    default 2

config UART_BAUDRATE
    int
    prompt "Config UART baudrate for TX test."
    depends on SAMPLE_SUPPORT_UART
    default 115200

config UART_TEST_FIXED_BYTE
    hex
    prompt "Config fixed TX byte in HEX."
    depends on SAMPLE_SUPPORT_UART
    default 0x55

config UART_TEST_SEND_INTERVAL_MS
    int
    prompt "Config TX interval(ms)."
    depends on SAMPLE_SUPPORT_UART
    default 100

config UART_SUPPORT_INT_MODE
    bool
    prompt "UART support interrupt mode."
    depends on SAMPLE_SUPPORT_UART
    default n

config UART_TRANSFER_SIZE
    int
    prompt "Config UART transfer size."
    depends on SAMPLE_SUPPORT_UART
    default 64
```
